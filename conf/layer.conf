## conf/layer.conf
```bitbake
# We have a conf and classes directory, add to BBPATH
BBPATH .= ":${LAYERDIR}"

# We have recipes-* directories, add to BBFILES
BBFILES += "${LAYERDIR}/recipes-*/*/*.bb \
            ${LAYERDIR}/recipes-*/*/*.bbappend"

BBFILE_COLLECTIONS += "meta-kcrash"
BBFILE_PATTERN_meta-kcrash = "^${LAYERDIR}/"
BBFILE_PRIORITY_meta-kcrash = "6"

LAYERDEPENDS_meta-kcrash = "core"
LAYERSERIES_COMPAT_meta-kcrash = "gatesgarth"
```
